/ {
    chosen {
        zmk,kscan = &default_kscan;
    };

    default_kscan: kscan {
        compatible = "zmk,kscan-gpio-direct";
        label = "default_kscan";

        input-gpios = <&pro_micro 22 GPIO_PULL_UP>,
                      <&pro_micro 24 GPIO_PULL_UP>;
    };
};
