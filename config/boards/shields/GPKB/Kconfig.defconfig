## config/boards/shields/GPKB/Kconfig.defconfig
```kconfig
if SHIELD_GPKB

config ZMK_KEYBOARD_NAME
    string "GPBK"

config USB_DEVICE_PRODUCT
    string "GPBK"

config BT_DEVICE_NAME
    string "GPBK"
endif
  
```
